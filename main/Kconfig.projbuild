## main/Kconfig.projbuild
```kconfig
menu "LightWarmCold Matter Configuration"
    config DEFAULT_BRIGHTNESS
        int "Default brigthness"
        default 64
        range 0 254

    config COLOR_TEMP_WARM
        int "Warm led color temperature"
        default 2200
        help
            Warm led color temperature in kelvins (min)

    config COLOR_TEMP_COLD
        int "Cold led color temperature"
        default 7000
        help
            Cold led color temperature in kelvins (max)

    config COLOR_TEMP_DEFAULT
        int "Startup color temperature"
        default 4600
        help 
            Startup color temperature in kelvins
endmenu

menu "LightWarmCold Hardware Configuration"
    config LED_WARM_GPIO
        int "Warm led GPIO number"
        default 4

    config LED_COLD_GPIO
        int "Cold led GPIO number"
        default 5

    config PWM_FREQUENCY
        int "Led PWM frequency"
        default 4000

    config BUTTON_GPIO
        int "Config button GPIO number"
        default 9

    config INDICATOR_LED_GPIO
        int "Indicator LED GPIO number"
        default 8
        
    config INDICATOR_LED_INVERT
        bool "Indicator LED inverted logic"
        default n

    config XIAO_ESP32C6_EXTERNAL_ANTENNA
        bool "Switch to external antenna for XIAO ESP3C6 module"
        depends on IDF_TARGET_ESP32C6

endmenu
```
